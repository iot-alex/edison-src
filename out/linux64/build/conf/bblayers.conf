## out/linux64/build/conf/bblayers.conf
```bitbake
# LAYER_CONF_VERSION is increased each time build/conf/bblayers.conf
# changes incompatibly
LCONF_VERSION = "6"

BBPATH = "${TOPDIR}"
BBFILES ?= ""
BBLAYERS ?= " \
  /home/alex/work/edison-src/out/linux64/poky/meta \
  /home/alex/work/edison-src/out/linux64/poky/meta-yocto \
  /home/alex/work/edison-src/out/linux64/poky/meta-yocto-bsp \
  /home/alex/work/edison-src/meta-intel-edison/meta-intel-edison-bsp \
  /home/alex/work/edison-src/meta-intel-edison/meta-intel-edison-distro \
  /home/alex/work/edison-src/out/linux64/poky/meta-intel-iot-middleware \
  /home/alex/work/edison-src/meta-intel-edison/meta-intel-arduino \
  /home/alex/work/edison-src/meta-arduino \
  \
  "
BBLAYERS_NON_REMOVABLE ?= " \
  /home/alex/work/edison-src/out/linux64/poky/meta \
  /home/alex/work/edison-src/out/linux64/poky/meta-yocto \
  "
```

## out/linux64/build/conf/local.conf
```bitbake
BB_NUMBER_THREADS = "32"
PARALLEL_MAKE = "-j 32"
MACHINE = "edison"
DISTRO = "poky-edison"
USER_CLASSES ?= "buildstats image-mklibs image-prelink"
PATCHRESOLVE = "noop"
CONF_VERSION = "1"
EDISONREPO_TOP_DIR = "/home/alex/work/edison-src"
DL_DIR ?= "/home/alex/work/edison-src/bitbake_download_dir"
SSTATE_DIR ?= "/home/alex/work/edison-src/bitbake_sstate_dir"
BUILDNAME = "Custom Edison build by alex@instance-00072538 2015-12-21 04:45:39 UTC"
LICENSE_FLAGS_WHITELIST += "commercial"
COPY_LIC_MANIFEST = "1"
COPY_LIC_DIRS = "1"
FILESYSTEM_PERMS_TABLES = "/home/alex/work/edison-src/meta-intel-edison/meta-intel-edison-distro/files/fs-perms.txt"


SDKMACHINE = "x86_64"
```
